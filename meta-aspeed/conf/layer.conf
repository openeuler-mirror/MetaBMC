## meta-aspeed/conf/layer.conf
```bitbake
# We have a conf and classes directory, add to BBPATH
BBPATH .= ":${LAYERDIR}"

# We have recipes-* directories, add to BBFILES
BBFILES += "${LAYERDIR}/recipes-*/*/*.bb ${LAYERDIR}/recipes-*/*/*.bbappend"

BBFILE_COLLECTIONS += "aspeed-layer"
BBFILE_PATTERN_aspeed-layer = "^${LAYERDIR}/"
BBFILE_PRIORITY_aspeed-layer = "40"

# This should only be incremented on significant changes that will
# cause compatibility issues with other layers
LAYERVERSION_aspeed-layer = "1"

LAYERDEPENDS_aspeed-layer = "core"

LAYERSERIES_COMPAT_aspeed-layer = "kirkstone"
```

## meta-openeuler/conf/layer.conf
```bitbake
# We have a conf and classes directory, add to BBPATH
BBPATH .= ":${LAYERDIR}"

# We have recipes-* directories, add to BBFILES
BBFILES += "${LAYERDIR}/recipes-*/*/*.bb ${LAYERDIR}/recipes-*/*/*.bbappend"

BBFILE_COLLECTIONS += "openeuler-layer"
BBFILE_PATTERN_openeuler-layer = "^${LAYERDIR}/"
BBFILE_PRIORITY_openeuler-layer = "40"

# This should only be incremented on significant changes that will
# cause compatibility issues with other layers
LAYERVERSION_openeuler-layer = "1"

LAYERDEPENDS_openeuler-layer = "core"

LAYERSERIES_COMPAT_openeuler-layer = "kirkstone"
```
